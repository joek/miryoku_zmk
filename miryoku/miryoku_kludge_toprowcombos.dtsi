// Copyright 2022 Manna Harbour
// https://github.com/manna-harbour/miryoku
#include "../zmk-nodefree-config/international_chars/german.dtsi"

// Windows-Alt-Codes variants for runtime unicode switching on U_EXTRA.
#undef OS_UNICODE_LEAD
#undef OS_UNICODE_TRAIL
#define OS_UNICODE_LEAD &macro_press &kp LALT
#define OS_UNICODE_TRAIL &macro_release &kp LALT
ZMK_UNICODE_PAIR(   de_ae_win,      KP_N0, KP_N2, KP_N2, KP_N8,    KP_N0, KP_N1, KP_N9, KP_N6)
ZMK_UNICODE_PAIR(   de_oe_win,      KP_N0, KP_N2, KP_N4, KP_N6,    KP_N0, KP_N2, KP_N1, KP_N4)
ZMK_UNICODE_PAIR(   de_ue_win,      KP_N0, KP_N2, KP_N5, KP_N2,    KP_N0, KP_N2, KP_N2, KP_N0)
ZMK_UNICODE_SINGLE( de_eszett_win,  KP_N0, KP_N2, KP_N2, KP_N3)

// Keep Linux unicode behavior as default for existing bindings.
#undef OS_UNICODE_LEAD
#undef OS_UNICODE_TRAIL
#define OS_UNICODE_LEAD &macro_tap &kp LS(LC(U))
#define OS_UNICODE_TRAIL &macro_tap &kp SPACE


#define MIRYOKU_KLUDGE_TOPROWCOMBOS_TERM 50
#define MIRYOKU_KLUDGE_TOPROWCOMBOS_MACRO(LAYER, POSITION, BINDING) \
toprowcombos_ ## LAYER ## _ ## POSITION { \
  layers = <LAYER>; \
  key-positions = <MIRYOKU_KLUDGE_TOPROWCOMBOS_ ## POSITION>; \
  bindings = <BINDING>; \
  timeout-ms = <MIRYOKU_KLUDGE_TOPROWCOMBOS_TERM>; \
};
/ {
  combos {
    compatible = "zmk,combos";
#if defined (MIRYOKU_LAYERS_FLIP)
  #if defined (MIRYOKU_ALPHAS_AZERTY)
    #error "Not implemented. See https://github.com/manna-harbour/miryoku/issues/56"
  #elif defined (MIRYOKU_ALPHAS_BEAKL15)
    #error "Not implemented. See https://github.com/manna-harbour/miryoku/issues/56"
  #elif defined (MIRYOKU_ALPHAS_COLEMAK)
    #error "Not implemented. See https://github.com/manna-harbour/miryoku/issues/56"
  #elif defined (MIRYOKU_ALPHAS_COLEMAKDHK)
    #error "Not implemented. See https://github.com/manna-harbour/miryoku/issues/56"
  #elif defined (MIRYOKU_ALPHAS_DVORAK)
    #error "Not implemented. See https://github.com/manna-harbour/miryoku/issues/56"
  #elif defined (MIRYOKU_ALPHAS_HALMAK)
    #error "Not implemented. See https://github.com/manna-harbour/miryoku/issues/56"
  #elif defined (MIRYOKU_ALPHAS_WORKMAN)
    #error "Not implemented. See https://github.com/manna-harbour/miryoku/issues/56"
  #elif defined (MIRYOKU_ALPHAS_QWERTY)
    #error "Not implemented. See https://github.com/manna-harbour/miryoku/issues/56"
  #elif defined (MIRYOKU_ALPHAS_QWERTZ)
    #error "Not implemented. See https://github.com/manna-harbour/miryoku/issues/56"
  #else
    #error "Not implemented. See https://github.com/manna-harbour/miryoku/issues/56"
  #endif
  #if defined (MIRYOKU_NAV_INVERTEDT)
    #error "Not implemented. See https://github.com/manna-harbour/miryoku/issues/56"
  #elif defined (MIRYOKU_NAV_VI)
    #error "Not implemented. See https://github.com/manna-harbour/miryoku/issues/56"
  #else
    #error "Not implemented. See https://github.com/manna-harbour/miryoku/issues/56"
  #endif
#else
  #if defined (MIRYOKU_ALPHAS_AZERTY)
    #error "Not implemented. See https://github.com/manna-harbour/miryoku/issues/56"
  #elif defined (MIRYOKU_ALPHAS_BEAKL15)
    #error "Not implemented. See https://github.com/manna-harbour/miryoku/issues/56"
  #elif defined (MIRYOKU_ALPHAS_COLEMAK)
    #error "Not implemented. See https://github.com/manna-harbour/miryoku/issues/56"
  #elif defined (MIRYOKU_ALPHAS_COLEMAKDHK)
    #error "Not implemented. See https://github.com/manna-harbour/miryoku/issues/56"
  #elif defined (MIRYOKU_ALPHAS_DVORAK)
    #error "Not implemented. See https://github.com/manna-harbour/miryoku/issues/56"
  #elif defined (MIRYOKU_ALPHAS_HALMAK)
    #error "Not implemented. See https://github.com/manna-harbour/miryoku/issues/56"
  #elif defined (MIRYOKU_ALPHAS_WORKMAN)
    #error "Not implemented. See https://github.com/manna-harbour/miryoku/issues/56"
  #elif defined (MIRYOKU_ALPHAS_QWERTY)
    MIRYOKU_KLUDGE_TOPROWCOMBOS_MACRO(U_BASE, LEFTPINKIE, &kp Q)
    MIRYOKU_KLUDGE_TOPROWCOMBOS_MACRO(U_BASE, LEFTINNERINDEX, &kp T)
    MIRYOKU_KLUDGE_TOPROWCOMBOS_MACRO(U_BASE, RIGHTINNERINDEX, &kp Y)
    MIRYOKU_KLUDGE_TOPROWCOMBOS_MACRO(U_BASE, RIGHTPINKIE, &kp P)
  #elif defined (MIRYOKU_ALPHAS_QWERTZ)
    #error "Not implemented. See https://github.com/manna-harbour/miryoku/issues/56"
  #else
    MIRYOKU_KLUDGE_TOPROWCOMBOS_MACRO(U_BASE, LEFTPINKIE, &de_ae)
    MIRYOKU_KLUDGE_TOPROWCOMBOS_MACRO(U_BASE, LEFTINNERINDEX, &de_oe)
    MIRYOKU_KLUDGE_TOPROWCOMBOS_MACRO(U_BASE, RIGHTINNERINDEX, &de_ue)
    MIRYOKU_KLUDGE_TOPROWCOMBOS_MACRO(U_BASE, RIGHTPINKIE, &de_eszett)
    MIRYOKU_KLUDGE_TOPROWCOMBOS_MACRO(U_EXTRA, LEFTPINKIE, &de_ae_win)
    MIRYOKU_KLUDGE_TOPROWCOMBOS_MACRO(U_EXTRA, LEFTINNERINDEX, &de_oe_win)
    MIRYOKU_KLUDGE_TOPROWCOMBOS_MACRO(U_EXTRA, RIGHTINNERINDEX, &de_ue_win)
    MIRYOKU_KLUDGE_TOPROWCOMBOS_MACRO(U_EXTRA, RIGHTPINKIE, &de_eszett_win)
  #endif
  #if defined (MIRYOKU_NAV_INVERTEDT)
    #error "Not implemented. See https://github.com/manna-harbour/miryoku/issues/56"
  #elif defined (MIRYOKU_NAV_VI)
    #error "Not implemented. See https://github.com/manna-harbour/miryoku/issues/56"
  #else
    MIRYOKU_KLUDGE_TOPROWCOMBOS_MACRO(U_NAV, LEFTPINKIE, &bootloader)
    MIRYOKU_KLUDGE_TOPROWCOMBOS_MACRO(U_NAV, LEFTINNERINDEX, U_NA)
    MIRYOKU_KLUDGE_TOPROWCOMBOS_MACRO(U_NAV, RIGHTINNERINDEX, U_RDO)
    MIRYOKU_KLUDGE_TOPROWCOMBOS_MACRO(U_NAV, RIGHTPINKIE, U_UND)

    MIRYOKU_KLUDGE_TOPROWCOMBOS_MACRO(U_MOUSE, LEFTPINKIE, &bootloader)
    MIRYOKU_KLUDGE_TOPROWCOMBOS_MACRO(U_MOUSE, LEFTINNERINDEX, U_NA)
    MIRYOKU_KLUDGE_TOPROWCOMBOS_MACRO(U_MOUSE, RIGHTINNERINDEX, U_RDO)
    MIRYOKU_KLUDGE_TOPROWCOMBOS_MACRO(U_MOUSE, RIGHTPINKIE, U_UND)

    MIRYOKU_KLUDGE_TOPROWCOMBOS_MACRO(U_MEDIA, LEFTPINKIE, &bootloader)
    MIRYOKU_KLUDGE_TOPROWCOMBOS_MACRO(U_MEDIA, LEFTINNERINDEX, U_NA)
  #endif
    MIRYOKU_KLUDGE_TOPROWCOMBOS_MACRO(U_NUM, LEFTPINKIE, &kp LBKT)
    MIRYOKU_KLUDGE_TOPROWCOMBOS_MACRO(U_NUM, LEFTINNERINDEX, &kp RBKT)
    MIRYOKU_KLUDGE_TOPROWCOMBOS_MACRO(U_NUM, RIGHTINNERINDEX, U_NA)
    MIRYOKU_KLUDGE_TOPROWCOMBOS_MACRO(U_NUM, RIGHTPINKIE, &bootloader)

    MIRYOKU_KLUDGE_TOPROWCOMBOS_MACRO(U_SYM, LEFTPINKIE, &kp LBRC)
    MIRYOKU_KLUDGE_TOPROWCOMBOS_MACRO(U_SYM, LEFTINNERINDEX, &kp RBRC)
    MIRYOKU_KLUDGE_TOPROWCOMBOS_MACRO(U_SYM, RIGHTINNERINDEX, U_NA)
    MIRYOKU_KLUDGE_TOPROWCOMBOS_MACRO(U_SYM, RIGHTPINKIE, &bootloader)

    MIRYOKU_KLUDGE_TOPROWCOMBOS_MACRO(U_FUN, LEFTPINKIE, &kp F12)
    MIRYOKU_KLUDGE_TOPROWCOMBOS_MACRO(U_FUN, LEFTINNERINDEX, &kp PSCRN)
    MIRYOKU_KLUDGE_TOPROWCOMBOS_MACRO(U_FUN, RIGHTINNERINDEX, U_NA)
    MIRYOKU_KLUDGE_TOPROWCOMBOS_MACRO(U_FUN, RIGHTPINKIE, &bootloader)
#endif
    MIRYOKU_KLUDGE_TOPROWCOMBOS_MACRO(U_BUTTON, LEFTPINKIE, U_UND)
    MIRYOKU_KLUDGE_TOPROWCOMBOS_MACRO(U_BUTTON, LEFTINNERINDEX, U_RDO)
    MIRYOKU_KLUDGE_TOPROWCOMBOS_MACRO(U_BUTTON, RIGHTINNERINDEX, U_RDO)
    MIRYOKU_KLUDGE_TOPROWCOMBOS_MACRO(U_BUTTON, RIGHTPINKIE, U_UND)
  };
};
